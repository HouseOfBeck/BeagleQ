/*
 * Copyright (C) 2012 Texas Instruments Incorporated - http://www.ti.com/
 *
 * This program is free software; you can redistribute it and/or modify
 * it under the terms of the GNU General Public License version 2 as
 * published by the Free Software Foundation.
 */
/dts-v1/;
/plugin/;

/ {
	compatible = "ti,beaglebone-black";

	/* identification */
	part-number = "BeagleQ-03";
	version = "00A0";

	fragment@0 {
       	 target = <&i2c2>;
        	__overlay__ {
            	status = "okay";
        	};
	};
};
